## firmware/esp32/main/Kconfig.projbuild
```kconfig
# SPDX-License-Identifier: Apache-2.0
menu "Robot Platform Configuration"

    menu "Build Mode"
        config PRODUCTION_BUILD
            bool "Production build"
            default n
            help
                Enable production hardening. Disables development Wi-Fi
                credential fallback, suppresses verbose logging of sensitive
                data, and enables structured logging output.

                WARNING: On real hardware, production builds require secure
                boot keys and NVS encryption keys to be provisioned. Enabling
                this on a device without provisioned keys will prevent boot.

        config STRUCTURED_LOGGING
            bool "Structured logging (logfmt)"
            default n
            help
                Output logs in machine-parseable logfmt format:
                ts=<ms> level=<L> tag=<T> event=<E> key=val ...
                Useful for fleet monitoring and log aggregation.
                Falls through to normal ESP_LOGx when disabled.
    endmenu

    choice ROBOT_SKU
        prompt "Robot SKU variant"
        default ROBOT_SKU_BASIC
        help
            Select the hardware SKU to configure available features.

        config ROBOT_SKU_BASIC
            bool "Basic (Education/Hobby)"
        config ROBOT_SKU_STANDARD
            bool "Standard (Research/Development)"
        config ROBOT_SKU_INDUSTRIAL
            bool "Industrial (Automation)"
    endchoice

    menu "Motor / Drivetrain"
        config MOTOR_GEAR_RATIO
            int "Gear reduction ratio"
            default 30 if ROBOT_SKU_INDUSTRIAL
            default 50 if ROBOT_SKU_STANDARD
            default 90
            help
                Motor gearbox reduction ratio.
                N20 motors (Basic): 90
                N20 motors (Standard): 50
                550 motors (Industrial): 30

        config MOTOR_ENCODER_PPR
            int "Encoder pulses per revolution (before quadrature)"
            default 120 if ROBOT_SKU_INDUSTRIAL
            default 360
            help
                Raw encoder PPR before quadrature decoding (x4).
                N20 Hall encoder: 360 PPR (CPR = 1440)
                550 Hall encoder: 120 PPR (CPR = 480)

        config MOTOR_MAX_RPM
            int "Max output shaft RPM"
            default 200 if ROBOT_SKU_INDUSTRIAL
            default 180 if ROBOT_SKU_STANDARD
            default 150
            help
                Maximum RPM at the output shaft (after gearbox).
                N20 1:90 at 6V (Basic): ~150 RPM
                N20 1:50 at 6V (Standard): ~180 RPM
                550 1:30 at 12V (Industrial): ~200 RPM

        config MOTOR_PWM_FREQ_HZ
            int "PWM frequency (Hz)"
            default 15000 if ROBOT_SKU_INDUSTRIAL
            default 20000
            help
                Motor driver PWM frequency.
                DRV8833 (Basic/Standard): 20000 Hz
                BTS7960 (Industrial): 15000 Hz
    endmenu

    menu "Chassis Geometry"
        config CHASSIS_WHEEL_RADIUS_MM_X10
            int "Wheel radius (mm x10, e.g. 240 = 24.0mm)"
            default 485 if ROBOT_SKU_INDUSTRIAL
            default 325 if ROBOT_SKU_STANDARD
            default 240
            help
                Wheel radius in tenths of mm (Kconfig int limitation).
                48mm wheel (Basic): 240 (= 24.0mm)
                65mm wheel (Standard): 325 (= 32.5mm)
                97mm wheel (Industrial): 485 (= 48.5mm)

        config CHASSIS_TRACK_WIDTH_MM
            int "Track width (mm, left-right wheel center distance)"
            default 320 if ROBOT_SKU_INDUSTRIAL
            default 260 if ROBOT_SKU_STANDARD
            default 200
            help
                Distance between left and right wheel centers.
                Basic (300x250 chassis): 200mm
                Standard (400x320 chassis): 260mm
                Industrial (500x400 chassis): 320mm

        config CHASSIS_WHEELBASE_MM
            int "Wheelbase (mm, front-rear axle distance)"
            default 300 if ROBOT_SKU_INDUSTRIAL
            default 240 if ROBOT_SKU_STANDARD
            default 180
            help
                Distance between front and rear axle centers.
                Basic (300x250 chassis): 180mm
                Standard (400x320 chassis): 240mm
                Industrial (500x400 chassis): 300mm
    endmenu

    menu "Robot Profile"
        choice ROBOT_PROFILE
            prompt "Operating Profile"
            default ROBOT_PROFILE_STANDARD
            help
                Select operational profile. Competition profile overrides motor
                parameters for high-speed RoboCup-style operation (1:30 gear,
                500 RPM, aggressive PID). Independent of SKU selection but
                intended for use with standard-version competition chassis.

            config ROBOT_PROFILE_STANDARD
                bool "Standard (conservative safety margins, commercial deployment)"
            config ROBOT_PROFILE_COMPETITION
                bool "Competition (aggressive PID, 1:30 gear ratio, 0.8m/s max)"
                help
                    Activates competition parameters for RoboCup Logistics League etc.
                    Requires N20 1:30 motor hardware and encoder with >=12 CPR.
                    Only use with standard-version competition chassis (300x250mm).
        endchoice

        config MOTOR_PWM_DUTY_CAP_PCT
            int "PWM duty cycle cap (percent)"
            default 85
            range 50 100
            help
                Maximum PWM duty cycle percentage. Protects DRV8833 from
                sustained full-duty thermal damage. 85% keeps RMS current
                below 1.0A (rated 1.2A), providing 20% thermal headroom.
    endmenu

    menu "Motor PID Tuning"
        config MOTOR_PID_KP
            int "Proportional gain (x100)"
            default 180 if ROBOT_PROFILE_COMPETITION
            default 120
            help
                PID Kp * 100. Default 120 = 1.20 (standard), 180 = 1.80 (competition)

        config MOTOR_PID_KI
            int "Integral gain (x100)"
            default 120 if ROBOT_PROFILE_COMPETITION
            default 80
            help
                PID Ki * 100. Default 80 = 0.80 (standard), 120 = 1.20 (competition)

        config MOTOR_PID_KD
            int "Derivative gain (x100)"
            default 2 if ROBOT_PROFILE_COMPETITION
            default 1
            help
                PID Kd * 100. Default 1 = 0.01 (standard), 2 = 0.02 (competition)
    endmenu

    menu "Communication"
        config WIFI_SSID
            string "Wi-Fi SSID (development fallback)"
            default "robot-platform"
            help
                Compile-time SSID used only when NVS wifi/ssid is empty.
                For deployed robots, provision via NVS at runtime.

        config WIFI_PASSWORD
            string "Wi-Fi Password (development fallback)"
            default ""
            help
                Compile-time password used only when NVS wifi/password is empty.
                For deployed robots, provision via NVS at runtime.

        config MICROROS_UART_BAUD
            int "micro-ROS UART baud rate"
            default 921600

        config CMD_UDP_PORT
            int "Command UDP port"
            default 8888

        config TELEMETRY_UDP_PORT
            int "Telemetry UDP port"
            default 9999
    endmenu

    menu "Safety"
        config ESTOP_ENABLED
            bool "Enable hardware E-stop monitoring"
            default y

        config CMD_VEL_TIMEOUT_MS
            int "cmd_vel timeout (ms)"
            default 500
            help
                Stop motors if no velocity command received within this period.

        config US_SAFETY_DISTANCE_CM
            int "Ultrasonic safety distance (cm)"
            default 5
            help
                Trigger emergency stop when any sensor reads below this distance.
    endmenu

    menu "Battery"
        config BATTERY_CAPACITY_MAH
            int "Battery capacity (mAh)"
            default 6000

        config BATTERY_CELLS
            int "Number of cells in series"
            default 2
    endmenu

    menu "Docking"
        config ROBOT_DOCKING_ENABLED
            bool "Enable charging dock support"
            default n
            help
                Enable charging contact detection via ADC pogo pin sense.
                Uses GPIO 9 (ADC1_CH8) which conflicts with US_ECHO_LEFT —
                builds with docking enabled must omit side ultrasonics.
    endmenu

    menu "Basic SKU Mode"
        config ROBOT_BASIC_STANDALONE
            bool "Standalone mode (no Pi 5, no micro-ROS)"
            default y if ROBOT_SKU_BASIC
            default n
            help
                Basic SKU runs as standalone ESP32-S3 platform without
                companion computer. Disables micro-ROS agent and UART to Pi 5.
                Enables WiFi UDP direct control (V1 protocol).
                Retains PID motor control, ultrasonic safety, and battery monitoring.
    endmenu

    menu "Current Sensing"
        config CURRENT_SENSE_ENABLED
            bool "Enable ACS712 motor current sensing"
            default y if ROBOT_SKU_INDUSTRIAL
            default n
            help
                Enable per-motor current sensing via ACS712 analog output.
                Provides overcurrent protection (soft limit 3A, hard limit 8A)
                and current telemetry on /motor/current topic.
                Requires ACS712 modules wired to ADC-capable GPIOs.

        config THERMAL_NTC_ENABLED
            bool "Enable NTC thermistor temperature measurement"
            default y if ROBOT_SKU_INDUSTRIAL
            default n
            help
                Read motor driver temperature from NTC thermistor via ADC.
                Supplements INA219 power-based thermal estimation.
                Safety system uses the higher of both readings.
    endmenu

endmenu
```
